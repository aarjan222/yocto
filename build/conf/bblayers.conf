## build/conf/bblayers.conf
```bitbake
# POKY_BBLAYERS_CONF_VERSION is increased each time build/conf/bblayers.conf
# changes incompatibly
POKY_BBLAYERS_CONF_VERSION = "2"

BBPATH = "${TOPDIR}"
BBFILES ?= ""

BBLAYERS ?= " \
  /home/aarjan/yocto/src/poky/meta \
  /home/aarjan/yocto/src/poky/meta-poky \
  /home/aarjan/yocto/src/poky/meta-yocto-bsp \
  /home/aarjan/yocto/src/meta-raspberrypi \
  /home/aarjan/yocto/src/meta-openembedded/meta-oe \
  /home/aarjan/yocto/src/meta-openembedded/meta-multimedia \
  /home/aarjan/yocto/src/meta-openembedded/meta-networking \
  /home/aarjan/yocto/src/meta-openembedded/meta-python \
  /home/aarjan/yocto/src/meta-mylayer \
  /home/aarjan/yocto/src/meta-myautolayer \
  "
```

## src/meta-myapp/conf/layer.conf
```bitbake
# We have a conf and classes directory, add to BBPATH
BBPATH .= ":${LAYERDIR}"

# We have recipes-* directories, add to BBFILES
BBFILES += "${LAYERDIR}/recipes-*/*/*.bb \
            ${LAYERDIR}/recipes-*/*/*.bbappend"

BBFILE_COLLECTIONS += "meta-mycapp"
BBFILE_PATTERN_meta-mycapp = "^${LAYERDIR}/"
BBFILE_PRIORITY_meta-mycapp = "6"

LAYERDEPENDS_meta-mycapp = "core"
LAYERSERIES_COMPAT_meta-mycapp = "scarthgap"
```

## src/meta-myimage/conf/layer.conf
```bitbake
# We have a conf and classes directory, add to BBPATH
BBPATH .= ":${LAYERDIR}"

# We have recipes-* directories, add to BBFILES
BBFILES += "${LAYERDIR}/recipes-*/*/*.bb \
            ${LAYERDIR}/recipes-*/*/*.bbappend"

BBFILE_COLLECTIONS += "meta-myimage"
BBFILE_PATTERN_meta-myimage = "^${LAYERDIR}/"
BBFILE_PRIORITY_meta-myimage = "6"

LAYERDEPENDS_meta-myimage = "core"
LAYERSERIES_COMPAT_meta-myimage = "scarthgap"
```
